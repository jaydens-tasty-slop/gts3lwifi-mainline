// SPDX-License-Identifier: BSD-3-Clause
/*
 * Merged into ../apq8096-samsung-gts3lwifi.dts on 2026-10-28. This file only
 * keeps the include chain working; the original test is in the git history
 * of github.com/wh1ter0z3/gts3lwifi-mainline (dts/test/test-battery.dts).
 */

#include "test-audio.dts"
