// SPDX-License-Identifier: BSD-3-Clause
/*
 * Merged into ../apq8096-samsung-gts3lwifi.dts on 2026-10-30. This file only
 * keeps old build commands and the test DTs that include it working; the
 * Volume and Home keys setup is in the main DTS.
 */

#include "../apq8096-samsung-gts3lwifi.dts"
