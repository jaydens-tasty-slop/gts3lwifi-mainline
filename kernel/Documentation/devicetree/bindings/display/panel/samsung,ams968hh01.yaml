## kernel/Documentation/devicetree/bindings/display/panel/samsung,ams968hh01.yaml
```yaml
# SPDX-License-Identifier: (GPL-2.0-only OR BSD-2-Clause)
%YAML 1.2
---
$id: http://devicetree.org/schemas/display/panel/samsung,ams968hh01.yaml#
$schema: http://devicetree.org/meta-schemas/core.yaml#

title: Samsung AMS968HH01 QXGA AMOLED panel (Anapass ANA38401 DDI)

maintainers:
  - psigod <psigod@example.com>

description:
  2048x1536 AMOLED panel driven over two MIPI DSI links in command mode,
  used in the Samsung Galaxy Tab S3. The panel node is a child of the
  master DSI controller and has two input ports.

allOf:
  - $ref: panel-common.yaml#

properties:
  compatible:
    const: samsung,ams968hh01

  reg:
    maxItems: 1

  vdd-supply:
    description: panel 3.3 V supply

  reset-gpios: true

  rotation: true

  tcon-ready-gpios:
    maxItems: 1
    description: input raised by the DDI once it accepts commands

  io-channels:
    maxItems: 1
    description:
      Temperature sensor near the panel. The DDI needs lower ELVSS values
      below 0 and below -20 degrees Celsius.

  io-channel-names:
    const: temperature

  ports:
    $ref: /schemas/graph.yaml#/properties/ports
    properties:
      port@0:
        $ref: /schemas/graph.yaml#/properties/port
        description: first (master) DSI link, carries commands and the left half
      port@1:
        $ref: /schemas/graph.yaml#/properties/port
        description: second DSI link, right half
    required:
      - port@0
      - port@1

required:
  - compatible
  - reg
  - vdd-supply
  - reset-gpios
  - tcon-ready-gpios
  - ports

additionalProperties: false

examples:
  - |
    #include <dt-bindings/gpio/gpio.h>
    #include <dt-bindings/iio/qcom,spmi-vadc.h>

    dsi {
        #address-cells = <1>;
        #size-cells = <0>;

        panel@0 {
            compatible = "samsung,ams968hh01";
            reg = <0>;

            vdd-supply = <&vreg_lcd_vdd_3p3>;
            reset-gpios = <&tlmm 143 GPIO_ACTIVE_LOW>;
            tcon-ready-gpios = <&tlmm 45 GPIO_ACTIVE_HIGH>;
            io-channels = <&pm8994_vadc VADC_LR_MUX4_PU1_AMUX_THM1>;
            io-channel-names = "temperature";
            rotation = <270>;

            ports {
                #address-cells = <1>;
                #size-cells = <0>;

                port@0 {
                    reg = <0>;
                    panel_in0: endpoint {
                        remote-endpoint = <&dsi0_out>;
                    };
                };

                port@1 {
                    reg = <1>;
                    panel_in1: endpoint {
                        remote-endpoint = <&dsi1_out>;
                    };
                };
            };
        };
    };

...
```

## kernel/Documentation/devicetree/bindings/extcon/siliconmitus,sm5705-muic.yaml
```yaml
# SPDX-License-Identifier: GPL-2.0-only OR BSD-2-Clause
%YAML 1.2
---
$id: http://devicetree.org/schemas/extcon/siliconmitus,sm5705-muic.yaml#
$schema: http://devicetree.org/meta-schemas/core.yaml#

title: Silicon Mitus SM5705 MUIC

maintainers:
  - psigod <psigod@example.com>

description:
  The MUIC (micro USB interface controller) of the SM5705 charger and fuel
  gauge IC. It answers on its own I2C address, detects the USB charger
  type (BC1.2) and switches the USB data lines. Its registers differ from
  the SM5502 family.

properties:
  compatible:
    const: siliconmitus,sm5705-muic

  reg:
    maxItems: 1

  interrupts:
    maxItems: 1

required:
  - compatible
  - reg
  - interrupts

additionalProperties: false

examples:
  - |
    #include <dt-bindings/interrupt-controller/irq.h>

    i2c {
      #address-cells = <1>;
      #size-cells = <0>;

      extcon@25 {
        compatible = "siliconmitus,sm5705-muic";
        reg = <0x25>;
        interrupts-extended = <&pm8994_gpios 4 IRQ_TYPE_LEVEL_LOW>;
      };
    };
```

## kernel/Documentation/devicetree/bindings/input/touchscreen/wacom,w9019.yaml
```yaml
# SPDX-License-Identifier: (GPL-2.0-only OR BSD-2-Clause)
%YAML 1.2
---
$id: http://devicetree.org/schemas/input/touchscreen/wacom,w9019.yaml#
$schema: http://devicetree.org/meta-schemas/core.yaml#

title: Wacom W9019 pen digitizer with Samsung firmware

maintainers:
  - jaydens-tasty-slop <325336397+jaydens-tasty-slop@users.noreply.github.com>

description:
  An electromagnetic pen digitizer on I2C, as in the Samsung Galaxy Tab S3
  (SM-T820). Samsung's firmware answers a query command with the
  digitizer's ranges and sends one coordinate packet per interrupt.

allOf:
  - $ref: touchscreen.yaml#

properties:
  compatible:
    const: wacom,w9019

  reg:
    maxItems: 1

  interrupts:
    maxItems: 1

  vdd-supply:
    description: 3.3 V supply

  fwe-gpios:
    maxItems: 1
    description:
      Firmware write enable, held low. High starts the boot loader instead
      of the firmware.

required:
  - compatible
  - reg
  - interrupts
  - vdd-supply

unevaluatedProperties: false

examples:
  - |
    #include <dt-bindings/gpio/gpio.h>
    #include <dt-bindings/interrupt-controller/irq.h>

    i2c {
        #address-cells = <1>;
        #size-cells = <0>;

        digitizer@56 {
            compatible = "wacom,w9019";
            reg = <0x56>;
            interrupt-parent = <&tlmm>;
            interrupts = <34 IRQ_TYPE_LEVEL_LOW>;
            vdd-supply = <&pen_vdd>;
            fwe-gpios = <&tlmm 24 GPIO_ACTIVE_HIGH>;
            touchscreen-inverted-x;
            touchscreen-inverted-y;
        };
    };
```

## kernel/Documentation/devicetree/bindings/media/i2c/samsung,s5k5e3.yaml
```yaml
# SPDX-License-Identifier: (GPL-2.0-only OR BSD-2-Clause)
%YAML 1.2
---
$id: http://devicetree.org/schemas/media/i2c/samsung,s5k5e3.yaml#
$schema: http://devicetree.org/meta-schemas/core.yaml#

title: Samsung S5K5E3 Image Sensor

description:
  Samsung S5K5E3 is a 5 megapixel image sensor, controlled over a serial
  camera control bus. The widest output frame size is 2576x1932 at 30
  frames per second, the data format is RAW10, transferred over a 2-lane
  MIPI D-PHY interface.

maintainers:
  - Jayden Milne <linux@jayd.ml>

allOf:
  - $ref: /schemas/media/video-interface-devices.yaml#

properties:
  compatible:
    const: samsung,s5k5e3

  reg:
    maxItems: 1

  clocks:
    description: MCLK supply clock.
    maxItems: 1

  reset-gpios:
    description: Active low GPIO connected to RESET pad of the sensor.
    maxItems: 1

  vdda-supply:
    description: Analogue voltage supply, 2.8 volts.

  vddd-supply:
    description: Digital core voltage supply, 1.2 volts.

  vddio-supply:
    description: Digital I/O voltage supply, 1.8 volts.

  port:
    $ref: /schemas/graph.yaml#/$defs/port-base
    additionalProperties: false

    properties:
      endpoint:
        $ref: /schemas/media/video-interfaces.yaml#
        unevaluatedProperties: false

        properties:
          data-lanes:
            items:
              - const: 1
              - const: 2

        required:
          - link-frequencies

required:
  - compatible
  - reg
  - port

unevaluatedProperties: false

examples:
  - |
      #include <dt-bindings/gpio/gpio.h>

      i2c {
          #address-cells = <1>;
          #size-cells = <0>;

          camera@10 {
              compatible = "samsung,s5k5e3";
              reg = <0x10>;
              clocks = <&camera_mclk 2>;
              assigned-clocks = <&camera_mclk 2>;
              assigned-clock-rates = <24000000>;
              reset-gpios = <&gpio1 40 GPIO_ACTIVE_LOW>;
              vdda-supply = <&vreg_2p8>;
              vddd-supply = <&vreg_1p2>;
              vddio-supply = <&vreg_1p8>;
              orientation = <0>;
              rotation = <270>;

              port {
                  endpoint {
                      data-lanes = <1 2>;
                      link-frequencies = /bits/ 64 <448000000>;
                      remote-endpoint = <&mipi_csi2_ep>;
                  };
              };
          };
      };
...
```

## kernel/Documentation/devicetree/bindings/power/supply/siliconmitus,sm5705-charger.yaml
```yaml
# SPDX-License-Identifier: GPL-2.0-only OR BSD-2-Clause
%YAML 1.2
---
$id: http://devicetree.org/schemas/power/supply/siliconmitus,sm5705-charger.yaml#
$schema: http://devicetree.org/meta-schemas/core.yaml#

title: Silicon Mitus SM5705 charger

maintainers:
  - psigod <psigod@example.com>

description:
  The charger part of the SM5705 charger and fuel gauge IC, a switch mode
  charger for one Li-ion cell from USB or wireless input. The same I2C
  device also controls the flash LED.

allOf:
  - $ref: power-supply.yaml#

properties:
  compatible:
    const: siliconmitus,sm5705-charger

  reg:
    maxItems: 1

  interrupts:
    maxItems: 1

  monitored-battery: true

  extcon:
    $ref: /schemas/types.yaml#/definitions/phandle
    description:
      The SM5705 MUIC, which reports the USB charger type. The input
      current limit follows it.

  power-supplies:
    maxItems: 1
    description:
      A USB Type-C controller supplying this charger. The input current
      limit also follows the current the USB-C source allows (Type-C
      current or PD contract), whichever of the two is higher.

required:
  - compatible
  - reg

unevaluatedProperties: false

examples:
  - |
    #include <dt-bindings/interrupt-controller/irq.h>

    i2c {
      #address-cells = <1>;
      #size-cells = <0>;

      charger@49 {
        compatible = "siliconmitus,sm5705-charger";
        reg = <0x49>;
        interrupts-extended = <&tlmm 38 IRQ_TYPE_LEVEL_LOW>;
        monitored-battery = <&battery>;
        extcon = <&muic>;
        power-supplies = <&typec>;
      };
    };
```

## kernel/Documentation/devicetree/bindings/power/supply/siliconmitus,sm5705-fuel-gauge.yaml
```yaml
# SPDX-License-Identifier: GPL-2.0-only OR BSD-2-Clause
%YAML 1.2
---
$id: http://devicetree.org/schemas/power/supply/siliconmitus,sm5705-fuel-gauge.yaml#
$schema: http://devicetree.org/meta-schemas/core.yaml#

title: Silicon Mitus SM5705 fuel gauge

maintainers:
  - psigod <psigod@example.com>

description:
  The fuel gauge part of the SM5705 charger and fuel gauge IC. It sits on
  its own I2C address and measures the battery voltage, current and
  temperature and computes the state of charge.

allOf:
  - $ref: power-supply.yaml#

properties:
  compatible:
    const: siliconmitus,sm5705-fuel-gauge

  reg:
    maxItems: 1

  interrupts:
    maxItems: 1
    description: Low state of charge alert

  monitored-battery: true

required:
  - compatible
  - reg

additionalProperties: false

examples:
  - |
    i2c {
      #address-cells = <1>;
      #size-cells = <0>;

      fuel-gauge@71 {
        compatible = "siliconmitus,sm5705-fuel-gauge";
        reg = <0x71>;
        monitored-battery = <&battery>;
      };
    };
```

## kernel/Documentation/devicetree/bindings/sound/richtek,rt5508.yaml
```yaml
# SPDX-License-Identifier: (GPL-2.0-only OR BSD-2-Clause)
%YAML 1.2
---
$id: http://devicetree.org/schemas/sound/richtek,rt5508.yaml#
$schema: http://devicetree.org/meta-schemas/core.yaml#

title: Richtek RT5508 Smart Speaker Amplifier

maintainers:
  - psigod <psigod@example.com>

description:
  The RT5508 is a mono Class-D speaker amplifier with an integrated boost
  converter, a DSP and speaker current/voltage sensing. It is controlled over
  I2C and takes audio over an I2S-style interface, either as a stereo frame or
  as a 4-slot TDM frame. In TDM mode it plays from one pair of slots (0/1 or
  2/3), using the first slot, the second slot or their average.

allOf:
  - $ref: dai-common.yaml#

properties:
  compatible:
    const: richtek,rt5508

  reg:
    maxItems: 1

  '#sound-dai-cells':
    const: 0

  richtek,channel-select:
    description: |
      Channel to play from the stereo frame, or from the selected slot pair
      in TDM mode.
        0 - left (first slot of the pair)
        1 - average of left and right
        2 - right (second slot of the pair)
    $ref: /schemas/types.yaml#/definitions/uint32
    enum: [0, 1, 2]
    default: 1

  richtek,tdm-dac-slot:
    description:
      Slot pair played in TDM mode, 0 for slots 0/1, 1 for slots 2/3.
    $ref: /schemas/types.yaml#/definitions/uint32
    enum: [0, 1]
    default: 0

  richtek,tdm-adc-slot:
    description:
      Slot pair the amplifier transmits its sense data in when in TDM mode,
      0 for slots 0/1, 1 for slots 2/3.
    $ref: /schemas/types.yaml#/definitions/uint32
    enum: [0, 1]
    default: 0

  richtek,data-out-enable:
    description:
      The data output of this amplifier is wired to the host. Amplifiers
      sharing one data line must not all drive it; set this on one of them.
    type: boolean

required:
  - compatible
  - reg
  - '#sound-dai-cells'

unevaluatedProperties: false

examples:
  - |
    i2c {
        #address-cells = <1>;
        #size-cells = <0>;

        amplifier@34 {
            compatible = "richtek,rt5508";
            reg = <0x34>;
            #sound-dai-cells = <0>;
            sound-name-prefix = "Speaker UR";
            richtek,channel-select = <2>;
            richtek,tdm-dac-slot = <1>;
            richtek,tdm-adc-slot = <1>;
        };

        amplifier@36 {
            compatible = "richtek,rt5508";
            reg = <0x36>;
            #sound-dai-cells = <0>;
            sound-name-prefix = "Speaker LR";
            richtek,channel-select = <0>;
            richtek,tdm-dac-slot = <1>;
            richtek,tdm-adc-slot = <1>;
            richtek,data-out-enable;
        };
    };
```

## kernel/Documentation/devicetree/bindings/usb/samsung,s2mm005.yaml
```yaml
# SPDX-License-Identifier: GPL-2.0-only OR BSD-2-Clause
%YAML 1.2
---
$id: http://devicetree.org/schemas/usb/samsung,s2mm005.yaml#
$schema: http://devicetree.org/meta-schemas/core.yaml#

title: Samsung S2MM005 USB Type-C and Power Delivery controller

maintainers:
  - psigod <psigod@example.com>

description:
  The S2MM005 is a USB Type-C port controller with a USB Power Delivery
  policy engine running in its own firmware, controlled over I2C. As a sink
  it negotiates a power contract with the source by itself, at 5 V; the host
  reads the attach state and the contract, and can have it request another
  fixed supply that the connector's sink-pdos allow. As a source it relies
  on the VBUS supply of the connector, and as a dual role data port on a
  USB role switch connected to the connector's high speed port. It raises
  its open-drain interrupt line while an event is pending.

properties:
  compatible:
    const: samsung,s2mm005

  reg:
    maxItems: 1

  interrupts:
    maxItems: 1

  connector:
    type: object
    $ref: /schemas/connector/usb-connector.yaml#
    unevaluatedProperties: false

required:
  - compatible
  - reg
  - interrupts

additionalProperties: false

examples:
  - |
    #include <dt-bindings/interrupt-controller/irq.h>
    #include <dt-bindings/usb/pd.h>

    i2c {
        #address-cells = <1>;
        #size-cells = <0>;

        typec@33 {
            compatible = "samsung,s2mm005";
            reg = <0x33>;
            interrupts-extended = <&tlmm 73 IRQ_TYPE_LEVEL_LOW>;

            connector {
                compatible = "usb-c-connector";
                label = "USB-C";
                power-role = "sink";
                data-role = "device";
                sink-pdos = <PDO_FIXED(5000, 3000, 0)
                             PDO_FIXED(9000, 1650, 0)>;
                op-sink-microwatt = <15000000>;
            };
        };
    };
```
